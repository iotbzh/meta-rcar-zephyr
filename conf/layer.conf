## conf/layer.conf
```bitbake
# We have a conf and classes directory, add to BBPATH
BBPATH =. "${LAYERDIR}:"

# We have recipes-* directories, add to BBFILES
BBFILES += "${LAYERDIR}/recipes-*/*/*.bb \
            ${LAYERDIR}/recipes-*/*/*.bbappend"

BBFILE_COLLECTIONS += "rcar-zephyr"
BBFILE_PATTERN_rcar-zephyr = "^${LAYERDIR}/"
BBFILE_PRIORITY_rcar-zephyr = "7"

LAYERSERIES_COMPAT_rcar-zephyr = "dunfell kirkstone"
```
